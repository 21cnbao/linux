## arch/arm/mach-demosoc/Kconfig
```kconfig
menu "Linux DEMOSOC"
	depends on ARCH_MULTI_V6 || ARCH_MULTI_V7

config ARCH_DEMOSOC
	bool "Linuxer demo soc(made by baohua)"
	help
          Support for Linuxer demo soc(made by baohua)

endif
```

## drivers/char/globalfifo/Kconfig
```kconfig
config LDDD3_GLOBALFIFO
	tristate "LDDD3 globalfifo driver example"
	default m
	---help---
	  LDDD3 globalfifo driver example. This device provides a in-kernel
	  4KB page as a FIFO which userspace app can use it as one IPC.
```

## drivers/char/globalmem/Kconfig
```kconfig
config LDDD3_GLOBALMEM
	tristate "LDDD3 globalmem driver example"
	default m
	---help---
	  LDDD3 globalmem driver example. This device provides a in-kernel
	  4KB page for reading/writing from userspace app by vfs interface.
```
